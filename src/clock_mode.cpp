#include "clock_mode.h"
#include "bsp_papermono.h"
#include "clock_font_large.h"
#include "clock_font_small.h"
#include "epd_driver.h"
#include <esp_log.h>

static constexpr const char* TAG = "MonoMesh-Clock";

namespace MonoMesh {

// Slack around a digit cell. The generated glyphs are not flat-bottomed: digits 0/2/3/5/6/8/9 (and
// the colon) carry 1-3 px of ink *below* the baseline, so the erased cell and the partial-refresh
// region must be the same rectangle, margin included. Erasing only [baseline-digitHeight, baseline)
// left that ink in the framebuffer, and the differential refresh re-displayed it as thin black lines
// under the digits (seen in the field on the portrait face).
static constexpr int CLOCK_MARGIN = 4;

// Blit one 1-bit glyph: every row is scanned for the runs of black pixels, each run is a fillRect.
// The bitmaps are already at the final resolution (generated by tools/gen_clock_font.py), so no
// scaling happens here: a 225 px digit is 225 px of real ink, not a 24 pt bitmap blown up 6x.
static void blitGlyph(M5GFX& gfx, int penX, int baselineY, const ClockGlyph& g) {
    const int x0 = penX + g.xOffset;
    const int y0 = baselineY + g.yOffset;
    const int rowBytes = (g.width + 7) / 8;
    for (int row = 0; row < g.height; ++row) {
        const uint8_t* bits = g.bitmap + (size_t)row * rowBytes;
        int col = 0;
        while (col < g.width) {
            while (col < g.width && !(bits[col >> 3] & (0x80 >> (col & 7)))) ++col;
            const int start = col;
            while (col < g.width && (bits[col >> 3] & (0x80 >> (col & 7)))) ++col;
            if (col > start) {
                gfx.fillRect(x0 + start, y0 + row, col - start, 1, TFT_BLACK);
            }
        }
    }
}

ClockMode::Layout ClockMode::layoutFor(bool landscape) const {
    Layout l;
    l.face.digits = landscape ? ClockFontLarge::kDigits : ClockFontSmall::kDigits;
    l.face.colon = landscape ? &ClockFontLarge::kColon : &ClockFontSmall::kColon;
    l.face.digitHeight = landscape ? ClockFontLarge::DIGIT_HEIGHT : ClockFontSmall::DIGIT_HEIGHT;
    l.face.digitAdvance = landscape ? ClockFontLarge::DIGIT_ADVANCE : ClockFontSmall::DIGIT_ADVANCE;
    l.face.colonAdvance = landscape ? ClockFontLarge::COLON_ADVANCE : ClockFontSmall::COLON_ADVANCE;
    l.centerX = (int)M5.Display.width() / 2;
    l.centerY = (int)M5.Display.height() / 2;
    const int totalW = 4 * l.face.digitAdvance + l.face.colonAdvance;
    l.x0 = l.centerX - totalW / 2;
    // Digits sit on the baseline: centre the digit ink box on the screen centre.
    l.baseline = l.centerY + l.face.digitHeight / 2;
    return l;
}

bool ClockMode::applyOrientation(bool landscape, bool flip180) {
    // Rotation 0..3 = portrait, landscape, portrait 180°, landscape 180°. The flip toggles the bit
    // that keeps the same aspect, so the fallback below can still rescue a swapped rotation table.
    const uint8_t rot = (uint8_t)((landscape ? 1 : 0) | (flip180 ? 2 : 0));
    M5.Display.setRotation(rot);
    if ((M5.Display.width() > M5.Display.height()) == landscape) return true;
    // The rotation table changed across M5GFX releases: try the mirrored mapping before giving up.
    M5.Display.setRotation(rot ^ 2);
    return (M5.Display.width() > M5.Display.height()) == landscape;
}

void ClockMode::drawFace(bool landscape, bool flip180) {
    applyOrientation(landscape, flip180);
    Layout l = layoutFor(landscape);

    int hh = 0, mm = 0, ss = 0;
    BSP::getInstance().getRtcTime(hh, mm, ss);
    const bool valid = BSP::getInstance().isRtcValid();

    M5.Display.setEpdMode(m5gfx::epd_mode_t::epd_quality);
    M5.Display.fillScreen(TFT_WHITE);
    drawTime(M5.Display, l, hh, mm, valid, true, true);
    M5.Display.display();
    M5.Display.waitDisplay();

    _lastValid = valid;
    _lastHour = valid ? (int16_t)hh : -1;
    _lastMinute = valid ? (int16_t)mm : -1;
    _partials = 0; // the quality pass above already cleaned the panel
    ESP_LOGI(TAG, "Clock face drawn (%s%s, %dx%d, digits %d px, %02d:%02d%s)",
             landscape ? "landscape" : "portrait", flip180 ? " 180" : "",
             M5.Display.width(), M5.Display.height(),
             l.face.digitHeight, hh, mm, valid ? "" : ", RTC not set");
}

void ClockMode::drawTime(M5GFX& gfx, const Layout& l, int hour, int minute, bool valid,
                         bool hourChanged, bool minuteChanged) {
    const Face& f = l.face;
    const int top = l.baseline - f.digitHeight;

    if (!valid) {
        // No RTC time yet: show --:-- instead of a fake 00:00 (same policy as the chat timestamps).
        // One centred dash per digit cell; the colon slot stays empty.
        gfx.fillRect(l.x0 - CLOCK_MARGIN, top - CLOCK_MARGIN,
                     4 * f.digitAdvance + f.colonAdvance + 2 * CLOCK_MARGIN,
                     f.digitHeight + 2 * CLOCK_MARGIN, TFT_WHITE);
        const int pens[4] = {
            l.x0,
            l.x0 + f.digitAdvance,
            l.x0 + 2 * f.digitAdvance + f.colonAdvance,
            l.x0 + 3 * f.digitAdvance + f.colonAdvance,
        };
        for (int i = 0; i < 4; ++i) {
            gfx.fillRect(pens[i] + f.digitAdvance / 4, l.baseline - f.digitHeight / 3,
                         f.digitAdvance / 2, f.digitHeight / 12, TFT_BLACK);
        }
        return;
    }

    const int colonX = l.x0 + 2 * f.digitAdvance;
    const int minuteX = colonX + f.colonAdvance;

    // Clear the cells that are about to be repainted, using the same margin the refresh covers: the
    // new digit can be narrower than the old one and the ink that dips below the baseline must go,
    // otherwise the differential refresh would keep the previous ink around it.
    if (hourChanged) {
        gfx.fillRect(l.x0 - CLOCK_MARGIN, top - CLOCK_MARGIN,
                     2 * f.digitAdvance + 2 * CLOCK_MARGIN, f.digitHeight + 2 * CLOCK_MARGIN, TFT_WHITE);
        blitGlyph(gfx, l.x0, l.baseline, f.digits[hour / 10]);
        blitGlyph(gfx, l.x0 + f.digitAdvance, l.baseline, f.digits[hour % 10]);
        blitGlyph(gfx, colonX, l.baseline, *f.colon);
    }
    if (minuteChanged) {
        gfx.fillRect(minuteX - CLOCK_MARGIN, top - CLOCK_MARGIN,
                     2 * f.digitAdvance + 2 * CLOCK_MARGIN, f.digitHeight + 2 * CLOCK_MARGIN, TFT_WHITE);
        blitGlyph(gfx, minuteX, l.baseline, f.digits[minute / 10]);
        blitGlyph(gfx, minuteX + f.digitAdvance, l.baseline, f.digits[minute % 10]);
    }
}

void ClockMode::refreshRegion(const Layout& l, bool hourChanged, bool minuteChanged) {
    const Face& f = l.face;
    int left = 0, right = -1;
    if (hourChanged) {
        left = l.x0;
        right = l.x0 + 2 * f.digitAdvance - 1;
    }
    if (minuteChanged) {
        const int mx = l.x0 + 2 * f.digitAdvance + f.colonAdvance;
        if (right < 0) {
            left = mx;
        } else {
            left = (mx < left) ? mx : left;
        }
        right = mx + 2 * f.digitAdvance - 1;
    }
    if (right < 0) return;

    // Same slack as the erase in drawTime(): the glyphs overshoot the baseline by a few pixels.
    const int x = left - CLOCK_MARGIN;
    const int y = l.baseline - f.digitHeight - CLOCK_MARGIN;
    const int w = (right - left + 1) + CLOCK_MARGIN * 2;
    const int h = f.digitHeight + CLOCK_MARGIN * 2;

    if (++_partials >= FULL_CLEAN_EVERY) {
        // Every FULL_CLEAN_EVERY minutes: a 4-level full refresh wipes the differential ghosting.
        _partials = 0;
        EPDDriver::getInstance().fullClear();
        return;
    }
    EPDDriver::getInstance().flushRect(x, y, w, h);
}

void ClockMode::maybeRefresh(bool landscape, bool flip180) {
    int hh = 0, mm = 0, ss = 0;
    BSP::getInstance().getRtcTime(hh, mm, ss);
    const bool valid = BSP::getInstance().isRtcValid();

    if (!valid) {
        if (!_lastValid) return; // already showing --:--
        drawFace(landscape, flip180); // RTC lost its time: redraw as --:--
        return;
    }
    if (!_lastValid) {
        drawFace(landscape, flip180); // first valid time since entering the mode
        return;
    }
    if (hh == _lastHour && mm == _lastMinute) return;

    const bool hourChanged = (hh != _lastHour);
    const bool minuteChanged = (mm != _lastMinute);
    Layout l = layoutFor(landscape);
    drawTime(M5.Display, l, hh, mm, true, hourChanged, minuteChanged);
    _lastHour = (int16_t)hh;
    _lastMinute = (int16_t)mm;
    refreshRegion(l, hourChanged, minuteChanged);
}

uint32_t ClockMode::msToNextMinute(uint32_t maxSliceMs) const {
    int hh = 0, mm = 0, ss = 0;
    BSP::getInstance().getRtcTime(hh, mm, ss);
    // The RTC second and millis() are not synchronized, so the estimate can be off by ~1 s: it only
    // aims the last slice at the boundary, the minute change itself is detected by reading the RTC.
    const uint32_t msIntoSecond = millis() % 1000UL;
    uint32_t remain = ((uint32_t)(60 - ss) * 1000UL) - msIntoSecond;
    if (remain < 100) remain = 100;
    if (remain > maxSliceMs) remain = maxSliceMs;
    return remain;
}

} // namespace MonoMesh
